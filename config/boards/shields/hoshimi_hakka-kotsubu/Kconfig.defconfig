## config/boards/shields/hoshimi_hakka-kotsubu/Kconfig.defconfig
```kconfig
if HOSHIMI_HAKKA-KOTSUBU

config ZMK_KEYBOARD_NAME
    default "hoshimi_hakka-kotsubu"

config SPI
    default y


endif
```

## config/boards/shields/hoshimi_hakka-kotsubu/Kconfig.shield
```kconfig
config HOSHIMI_HAKKA-KOTSUBU
    def_bool $(shields_list_contains,hoshimi_hakka-kotsubu)
```

## config/boards/shields/hoshimihakka-kotsubu/Kconfig.defconfig
```kconfig
if HOSHIMIHAKKA-KOTSUBU

config ZMK_KEYBOARD_NAME
    default "hoshimihakka-kotsubu"

config SPI
    default y


endif
```

## config/boards/shields/hoshimihakka-kotsubu/Kconfig.shield
```kconfig
config HOSHIMIHAKKA-KOTSUBU
    def_bool $(shields_list_contains,hoshimihakka-kotsubu)
```

## config/boards/shields/kotsubu/Kconfig.defconfig
```kconfig
if KOTSUBU

config ZMK_KEYBOARD_NAME
    default "kotsubu"

config SPI
    default y


endif
```
